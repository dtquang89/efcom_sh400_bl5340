## boards/efcom/sh400_bl5340/Kconfig.sh400_bl5340
```kconfig
# SH400 BL5340 board configuration

# Copyright (c) 2021 Laird Connectivity
# SPDX-License-Identifier: Apache-2.0

config BOARD_SH400_BL5340
	select SOC_NRF5340_CPUAPP_QKAA if BOARD_SH400_BL5340_NRF5340_CPUAPP
	select SOC_NRF5340_CPUAPP_QKAA if BOARD_SH400_BL5340_NRF5340_CPUAPP_NS
	select SOC_NRF5340_CPUNET_QKAA if BOARD_SH400_BL5340_NRF5340_CPUNET
```

## boards/efcom/sh400_bl5340/board.yml
```yaml
board:
  name: sh400_bl5340
  full_name: SH400 BL5340
  vendor: efcom
  socs:
    - name: "nrf5340"
      variants:
        - name: "ns"
          cpucluster: "cpuapp"
```

## dts/bindings/audio/richtek,rt9123.yaml
```yaml
title: "Richtek RT9123 Audio Amplifier Binding"
description: "RT9123 Audio Amplifier"
compatible: "richtek,rt9123"
on-bus: "i2c"

properties:
  reg:
    description: "I2C 7-bit address"
    required: true
    type: int
  vdd-supply:
    description: "Optional supply voltage"
    type: phandle
```

## dts/bindings/rtc/adi,max31341.yaml
```yaml
# SPDX-License-Identifier: Apache-2.0
title: Analog Devices MAX31341C Real-Time Clock (RTC), I2C
description: |
  Device binding for the MAX31341C RTC (Real-Time Clock) on an I²C bus.
  Supports features such as alarms, trickle-charger, external clock input.
  Based on the MAX31341B/MAX31341C datasheet.

compatible: "adi,max31341"

include: i2c-device.yaml

properties:
  reg:
    required: true

  int-gpios:
    type: phandle-array
    description: |
      Host input connected to the MAX31341C open drain output pin
      Notifies when an alarm has triggered by asserting this line.
```

## lib/Kconfig
```kconfig
# Copyright (c) 2021 Legrand North America, LLC.
# SPDX-License-Identifier: Apache-2.0

menu "Libraries"

rsource "ble/Kconfig"
rsource "uart/Kconfig"
rsource "adc/Kconfig"
rsource "gpio/Kconfig"
rsource "pwm/Kconfig"
rsource "sdcard/Kconfig"
rsource "i2c/Kconfig"

endmenu
```

## lib/adc/Kconfig
```kconfig
# SPDX-License-Identifier: Apache-2.0
menuconfig ANALOG_WRAPPER
    bool "Analog battery measurement library"
    default n
    select ADC
    help
      Enable a tiny ADC battery measurement helper.

if ANALOG_WRAPPER

config ANALOG_WRAPPER_LOG_LEVEL
    int "Log level"
    default 3
    range 0 4
    help
      0: None, 1: Err, 2: Warn, 3: Inf, 4: Debug

endif # ANALOG_WRAPPER
```

## lib/ble/Kconfig
```kconfig
# Copyright (c) 2021, Legrand North America, LLC.
# SPDX-License-Identifier: Apache-2.0

config EFCOM_LIB_BLE
	bool "BLE wrapper library"
	default n
	help
	  This option enables the BLE wrapper library
```

## lib/gpio/Kconfig
```kconfig
# Copyright (c) 2021, Legrand North America, LLC.
# SPDX-License-Identifier: Apache-2.0

config GPIO_WRAPPER
	bool "GPIO wrapper"
	default n
	select GPIO
	help
	  This is the tiny library for button with long press support.
```

## lib/i2c/Kconfig
```kconfig
# Copyright (c) 2021, Legrand North America, LLC.
# SPDX-License-Identifier: Apache-2.0

config I2C_WRAPPER
	bool "PWM wrapper"
	default n
	select I2C
	help
	  This is the tiny library for PWM to control RGB LED.
```

## lib/pwm/Kconfig
```kconfig
# Copyright (c) 2021, Legrand North America, LLC.
# SPDX-License-Identifier: Apache-2.0

config PWM_WRAPPER
	bool "PWM wrapper"
	default n
	select PWM
	help
	  This is the tiny library for PWM to control RGB LED.
```

## lib/sdcard/Kconfig
```kconfig
# Copyright (c) 2021, Legrand North America, LLC.
# SPDX-License-Identifier: Apache-2.0

config SD_CARD_LIB
	bool "SD Card Support"
	default n
	help
	  This option enables the sdcard library
```

## lib/uart/Kconfig
```kconfig
# SPDX-License-Identifier: Apache-2.0
menuconfig UART_WRAPPER
    bool "UART wrapper library"
    default n
    select SERIAL
    help
      Enable a tiny UART wrapper helper.

if UART_WRAPPER

config UART_WRAPPER_LOG_LEVEL
    int "Log level"
    default 3
    range 0 4
    help
      0: None, 1: Err, 2: Warn, 3: Inf, 4: Debug

config UART_BUFFER_SIZE
	int "UART payload buffer element size"
	default 40
	help
	  Size of the payload buffer in each RX and TX FIFO element

endif # UART_WRAPPER
```

## samples/spi/Kconfig
```kconfig
mainmenu "SPI Loopback Test"

source "Kconfig.zephyr"

config SPI_LOOPBACK_MODE_LOOP
	bool "Configure the SPI in LOOP mode, so that no extra wiring is needed"

config SPI_LARGE_BUFFER_SIZE
	int "Large buffer size"
	default 8192

config SPI_IDEAL_TRANSFER_DURATION_SCALING
	int "Scaling factor to compare ideal and measured SPI transfer duration"
	default 8
```
