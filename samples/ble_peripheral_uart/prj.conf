## CMakeLists.txt
```
#
# Copyright (c) 2018 Nordic Semiconductor
#
# SPDX-License-Identifier: LicenseRef-Nordic-5-Clause
#
cmake_minimum_required(VERSION 3.20.0)

list(APPEND OVERLAY_CONFIG
  ${CMAKE_CURRENT_SOURCE_DIR}/../../overlays/segger-rtt.conf
)

find_package(Zephyr REQUIRED HINTS $ENV{ZEPHYR_BASE})
project(NONE)

# NORDIC SDK APP START
target_sources(app PRIVATE
  src/main.c
)

# NORDIC SDK APP END
```

## prj.conf
```kconfig
#
# Copyright (c) 2018 Nordic Semiconductor
#
# SPDX-License-Identifier: LicenseRef-Nordic-5-Clause
#

CONFIG_BT=y
CONFIG_BT_PERIPHERAL=y
CONFIG_BT_DEVICE_NAME="Efcom_UART_Service"
CONFIG_BT_MAX_CONN=1
CONFIG_BT_MAX_PAIRED=1

CONFIG_BT_GATT_CLIENT=y
CONFIG_BT_USER_PHY_UPDATE=y
CONFIG_BT_USER_DATA_LEN_UPDATE=y
CONFIG_BT_BUF_ACL_TX_SIZE=251
CONFIG_BT_BUF_ACL_RX_SIZE=251
CONFIG_BT_L2CAP_TX_MTU=247

CONFIG_TFM_PROFILE_TYPE_NOT_SET=y

# Don't get entropy from HCI on nRF5340 devices
CONFIG_BT_HOST_CRYPTO_PRNG=y
CONFIG_ENTROPY_BT_HCI=n

# Enable wrapper BLE library
CONFIG_EFCOM_LIB_BLE=y

# Enable the NUS service
CONFIG_BT_NUS=y

# Enable bonding
CONFIG_BT_SETTINGS=y
CONFIG_FLASH=y
CONFIG_FLASH_PAGE_LAYOUT=y
CONFIG_FLASH_MAP=y
CONFIG_NVS=y
CONFIG_SETTINGS=y

# This example requires more stack
CONFIG_MAIN_STACK_SIZE=2048
CONFIG_SYSTEM_WORKQUEUE_STACK_SIZE=2048
```

## src/main.c
```c
/*
 * Copyright (c) 2018 Nordic Semiconductor ASA
 *
 * SPDX-License-Identifier: LicenseRef-Nordic-5-Clause
 */

/** @file
 *  @brief Nordic UART Bridge Service (NUS) sample
 */
#include <zephyr/device.h>
#include <zephyr/devicetree.h>
#include <zephyr/drivers/uart.h>
#include <zephyr/kernel.h>
#include <zephyr/logging/log.h>

LOG_MODULE_REGISTER(app, CONFIG_LOG_DEFAULT_LEVEL);

#include "ble.h"

#define BUFFER_SIZE CONFIG_BT_NUS_UART_BUFFER_SIZE

struct buffer_data_t
{
    uint8_t data[BUFFER_SIZE];
    uint16_t len;
};

/* Perform an echo test */
static void ble_receive_cb(const uint8_t* data, uint16_t len)
{
    uint16_t pos = 0;
    while (pos < len) {
        struct buffer_data_t* tx = k_malloc(sizeof(*tx));
        if (!tx) {
            LOG_WRN("Buffer alloc fail");
            return;
        }
        size_t chunk = MIN(sizeof(tx->data) - 1, len - pos);
        memcpy(tx->data, &data[pos], chunk);
        tx->len = chunk;
        pos += chunk;
        /* Append LF if peer sent CR */
        if ((pos == len && data[len - 1] == '\r') && tx->len < sizeof(tx->data)) {
            tx->data[tx->len++] = '\n';
        }

        // Do whatever you want with the received data
        // Print the data to the log
        LOG_INF("Received data from BLE: %.*s, len=%d", tx->len, tx->data, tx->len);

        // For example, send back the data to BLE to create a echo example
        ble_send(tx->data, tx->len);

        k_free(tx);
    }
}

int main(void)
{
    LOG_INF("Starting Bluetooth Peripheral UART example");

    /* Bring up BLE and register callbacks */
    int err = ble_init(NULL);
    if (err) {
        LOG_ERR("BLE init failed: %d", err);
        return 0;
    }

    ble_register_rx_callback(ble_receive_cb);
    ble_register_conn_callback(NULL); /* or provide your own, can be used to handling different connection state, like LED indicator */

    while (1) {
        k_sleep(K_SECONDS(1));
    }
}
```
