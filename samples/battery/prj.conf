## CMakeLists.txt
```
# SPDX-License-Identifier: Apache-2.0
cmake_minimum_required(VERSION 3.20.0)

list(APPEND OVERLAY_CONFIG
  ${CMAKE_CURRENT_SOURCE_DIR}/../../overlays/segger-rtt.conf
)

find_package(Zephyr REQUIRED HINTS $ENV{ZEPHYR_BASE})
project(battery)

# NORDIC SDK APP START
target_sources(app PRIVATE
  src/main.c
)
```

## prj.conf
```kconfig
CONFIG_ANALOG_WRAPPER=y
```

## src/main.c
```c
/**
 * @file main.c
 * @author Quang Duong
 * @brief Battery measurement sample.
 * @version 0.1
 * @date 2025-09-17
 *
 * @copyright Copyright (c) 2025
 *
 */

#include <zephyr/device.h>
#include <zephyr/kernel.h>
#include <zephyr/logging/log.h>

#include "analog_wrapper.h"
#include "dt_interfaces.h"

LOG_MODULE_REGISTER(app, LOG_LEVEL_INF);

/* Build ADC channel spec directly from devicetree */
static struct adc_dt_spec adc_channel =
#if HAS_VOLTAGE_DIVIDER
    ADC_DT_SPEC_GET(VBATT_NODE)
#else
    ADC_SPEC
#endif
    ;

/* Analog wrapper context */
static struct analog_control_t adc_ctx;

/**
 * @brief Pre-measurement callback for analog read.
 *
 * @param user_handle User context pointer.
 */
static void pre_measurement_cb(void* user_handle);

/**
 * @brief Post-measurement callback for analog read.
 *
 * @param user_handle User context pointer.
 */
static void post_measurement_cb(void* user_handle);

/**
 * @brief Main entry point for battery measurement sample.
 *
 * Initializes ADC, registers callbacks, and periodically reads battery voltage.
 *
 * @return 0 Always returns 0.
 */
int main(void)
{
    LOG_INF("Starting Battery measurement sample");

    int ret;
    int32_t batt_mv;
    int batt_pct;

#if !HAS_VOLTAGE_DIVIDER
    LOG_INF("No voltage divider configured, make sure the input voltage is within the ADC range!");
#else
    LOG_INF("Using voltage divider");
#endif

    /* Initialize wrapper */
    ret = analog_init(&adc_ctx, &adc_channel);
    if (ret) {
        LOG_ERR("ADC init failed (%d)", ret);
        return 0;
    }

    /* Register callbacks */
    analog_callbacks_t cbs = {
        .pre_measurement = pre_measurement_cb,
        .post_measurement = post_measurement_cb,
    };
    analog_register_callbacks(&adc_ctx, &cbs, NULL);

    while (1) {
        ret = analog_read_battery_mv(&adc_ctx, &batt_mv);
        if (ret) {
            LOG_ERR("Failed to read battery voltage (%d)", ret);
        }
        else {
            batt_pct = analog_get_battery_level(&adc_ctx, 1100, 3300);
            LOG_INF("Battery: %d mV (%d%%)", batt_mv, batt_pct);
        }

        k_sleep(K_SECONDS(2));
    }

    /* Not reached, but if you ever stop: */
    analog_deinit(&adc_ctx);

    return 0;
}
```
