## CMakeLists.txt
```
#-------------------------------------------------------------------------------
# Main Application
#
# Copyright (c) 2021 Nordic Semiconductor ASA
# SPDX-License-Identifier: Apache-2.0

cmake_minimum_required(VERSION 3.13.1)

# check if debug build
set(is_debug_build FALSE)

if(CMAKE_BUILD_TYPE)
    # add debug overlay for main application
    string(TOLOWER ${CMAKE_BUILD_TYPE} build_type_lower)

    if((${build_type_lower} STREQUAL "develop") OR(${build_type_lower} STREQUAL "debug"))
        set(is_debug_build TRUE)
    endif()
endif()

if(is_debug_build)
    message(STATUS "> building a DEBUG build (Segger RTT activated)")
    
    list(APPEND OVERLAY_CONFIG
    ${CMAKE_CURRENT_SOURCE_DIR}/../overlays/segger-rtt.conf
    )
endif()

find_package(Zephyr REQUIRED HINTS $ENV{ZEPHYR_BASE})

project(app LANGUAGES C)

target_sources(app PRIVATE src/main.c)
```

## sample.yaml
```
# This file is provided so that the application can be compiled using Twister,
# the Zephyr testing tool. In this file, multiple combinations can be specified,
# so that you can easily test all of them locally or in CI.
sample:
  description: main application
  name: main-application
common:
  build_only: true
  integration_platforms:
    - sh400_bl5340
tests:
  app.default: {}
  app.debug:
    extra_overlay_confs:
      - debug.conf
```

## prj.conf
```kconfig
# Copyright (c) 2021 Nordic Semiconductor ASA
# SPDX-License-Identifier: Apache-2.0
#
# This file contains selected Kconfig options for the application.

####################
### Miscellaneous
####################
CONFIG_SPEED_OPTIMIZATIONS=y
CONFIG_SIZE_OPTIMIZATIONS=y
CONFIG_MULTITHREADING=y
CONFIG_MPU_STACK_GUARD=y
CONFIG_HW_STACK_PROTECTION=y
CONFIG_HEAP_MEM_POOL_SIZE=1024
CONFIG_MAIN_STACK_SIZE=4096
CONFIG_SYSTEM_WORKQUEUE_STACK_SIZE=9192
CONFIG_ASSERT=y
CONFIG_REBOOT=y
CONFIG_BOOT_BANNER=n

CONFIG_RESET_ON_FATAL_ERROR=y
```

## debug.conf
```kconfig
# Copyright (c) 2021 Nordic Semiconductor ASA
# SPDX-License-Identifier: Apache-2.0
#
# This is a Kconfig fragment which can be used to enable debug-related options
# in the application. See the README for more details.

################################################################################
#
# Configuration for RTT support
#
# date: 16.01.2024
#
################################################################################

####################
### Enable/Disable logs
####################
CONFIG_LOG=y
CONFIG_LOG_DEFAULT_LEVEL=4

# ####################
# # SEGGER RTT
# ####################
CONFIG_USE_SEGGER_RTT=y
CONFIG_RTT_CONSOLE=y
CONFIG_UART_CONSOLE=n
CONFIG_LOG_BACKEND_RTT=y
CONFIG_LOG_BACKEND_UART=n

CONFIG_TRACING=y
CONFIG_TRACING_SYSCALL=y
CONFIG_EXTRA_EXCEPTION_INFO=y
CONFIG_ASSERT_VERBOSE=y

CONFIG_SEGGER_RTT_BUFFER_SIZE_DOWN=12288
CONFIG_SEGGER_RTT_BUFFER_SIZE_UP=12288
```

## src/main.c
```c
/*
 * Copyright (c) 2016 Intel Corporation
 *
 * SPDX-License-Identifier: Apache-2.0
 */

#include <stdio.h>
#include <zephyr/drivers/gpio.h>
#include <zephyr/kernel.h>
#include <zephyr/logging/log.h>

LOG_MODULE_REGISTER(main);

/* 1000 msec = 1 sec */
#define SLEEP_TIME_MS 1000

/* The devicetree node identifier for the "led0" alias. */
#define LED0_NODE DT_ALIAS(led0)

/*
 * A build error on this line means your board is unsupported.
 * See the sample documentation for information on how to fix this.
 */
static const struct gpio_dt_spec led = GPIO_DT_SPEC_GET(LED0_NODE, gpios);

int main(void)
{
    int ret;
    bool led_state = true;

    LOG_INF("Starting the application...");

    if (!gpio_is_ready_dt(&led)) {
        return 0;
    }

    ret = gpio_pin_configure_dt(&led, GPIO_OUTPUT_ACTIVE);
    if (ret < 0) {
        return 0;
    }

    LOG_INF("GPIO configuration done.");

    while (1) {
        ret = gpio_pin_toggle_dt(&led);
        if (ret < 0) {
            return 0;
        }

        led_state = !led_state;
        LOG_INF("LED state: %s", led_state ? "ON" : "OFF");
        k_msleep(SLEEP_TIME_MS);
    }
    return 0;
}
```
